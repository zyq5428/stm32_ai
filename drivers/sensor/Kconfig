## drivers/sensor/Kconfig
```kconfig
# Sensor driver configuration options
rsource "aht10/Kconfig"
rsource "ap3216c/Kconfig"
rsource "icm20608/Kconfig"
```

## drivers/sensor/aht10/Kconfig
```kconfig
# AHT10 temperature and humidity sensor configuration options
# 参照: aosong/dht20/Kconfig

config AHT10
	bool "AHT10 Temperature and Humidity Sensor"
	default y
	depends on DT_HAS_AOSONG_AHT10_ENABLED
	select I2C
	help
	  Enable driver for AHT10 I2C-based temperature and humidity sensor.
```

## drivers/sensor/ap3216c/Kconfig
```kconfig
# AP3216C Ambient Light and Proximity sensor configuration options

config AP3216C
	bool "AP3216C Ambient Light & Proximity Sensor"
	default y
	depends on DT_HAS_LITEON_AP3216C_ENABLED
	select I2C
	help
	  Enable driver for AP3216C I2C-based ambient light, proximity,
	  and IR sensor.
```

## drivers/sensor/icm20608/Kconfig
```kconfig
# ICM20608 Six-Axis Motion Tracking device configuration options
# 参照: tdk/mpu6050/Kconfig

menuconfig ICM20608
	bool "ICM20608 Six-Axis Motion Tracking Device"
	default y
	depends on DT_HAS_INVENSENSE_ICM20608_ENABLED
	select I2C
	help
	  Enable driver for ICM20608 I2C-based six-axis motion tracking device.
```
